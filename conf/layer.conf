## conf/layer.conf
```bitbake
BBPATH .= ":${LAYERDIR}"

BBFILES += "${LAYERDIR}/recipes-*/*/*.bb \
            ${LAYERDIR}/recipes-*/*/*.bbappend"

BBFILE_COLLECTIONS += "lfr"
BBFILE_PATTERN_lfr := "^${LAYERDIR}/"

LAYERSERIES_COMPAT_lfr = "zeus"

# Prefer the internal recipes by default
# Users can override this to use the external package
PREFERRED_PROVIDER_virtual/lfr = "lfr-package"
PREFERRED_PROVIDER_virtual/lfr-traplinker = "lfr-traplinker"
PREFERRED_PROVIDER_virtual/lfr-traplinker-native = "lfr-traplinker-package-native"
# Select the correct lfr package for the target architecture
# LFR_PACKAGE = "https://runsafesecurity.jfrog.io/artifactory/yocto/yocto-3.0.1/lfr-package-armv7vet2hf-neon-qemuarm-3.0.1.tar.xz"
INHERIT += "selfrandomize"
LFR_REPLACE_LD = "1"
# Please contact support@runsafesecurity.com to obtain a license.
# ALKEMIST_LICENSE_KEY = "<Put key here>"
```
